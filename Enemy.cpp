#include "AgSTG.h"
using namespace AgSTG;
uint16_t Texture_Enemy00_d[] PROGMEM={0x7E0, 0x7E0, 0x7E0, 0x7E0, 0x7E0, 0x7E0, 0x7E0, 0x7E0, 0x7E0, 0x7E0, 0x1B, 0x1B, 0x7E0,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 0x7E0, };
uint16_t Texture_Enemy01_d[] PROGMEM={0x7E0, 0x7E0, 0x7E0, 0x1B, 0x1B, 0x94BF, 0x94BF, 0x1B, 0x1B, 0x7E0, 0x7E0, 0x7E0, 0x7E0,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 0x7E0, };
uint16_t Texture_Enemy02_d[] PROGMEM={0x7E0, 0x7E0, 0x1B, 0x94BF, 0x7E0, 0x7E0, 0x7E0, 0x7E0, 0x7E0, 0x7E0, 0x7E0, 0x7E0, 0x7E0,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 0x7E0, };
uint16_t Texture_Enemy10_d[] PROGMEM={0x7E0, 0x7E0, 0x7E0, 0x7E0, 0x7E0, 0x7E0, 0x7E0, 0x7E0, 0x7E0, 0x7E0, 0xE8E6, 0xE8E6, 0x7E0,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 0x7E0, };
uint16_t Texture_Enemy11_d[] PROGMEM={0x7E0, 0x7E0, 0x7E0, 0xE8E6, 0xE8E6, 0xFDF8, 0xFDF8, 0xE8E6, 0xE8E6, 0x7E0, 0x7E0, 0x7E0, 0x7E0,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 0x7E0, };
uint16_t Texture_Enemy12_d[] PROGMEM={0x7E0, 0x7E0, 0xE8E6, 0xFDF8, 0x7E0, 0x7E0, 0x7E0, 0x7E0, 0x7E0, 0x7E0, 0x7E0, 0x7E0, 0x7E0,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 0x7E0, };
uint16_t Texture_Boss0_d[] PROGMEM={0x7E0, 0x7E0, 0x7E0, 0x7E0, 0x7E0, 0x7E0, 0x7E0, 0x7E0, 0x7E0, 0x7E0, 0x7E0, 0x7E0, 0x7E0,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 0x7E0, };
Bitmap Texture_Enemy00 = Bitmap(18,24,Texture_Enemy00_d);
Bitmap Texture_Enemy01 = Bitmap(18,24,Texture_Enemy01_d);
Bitmap Texture_Enemy02 = Bitmap(18,24,Texture_Enemy02_d);
Bitmap Texture_Enemy10 = Bitmap(18,24,Texture_Enemy10_d);
Bitmap Texture_Enemy11 = Bitmap(18,24,Texture_Enemy11_d);
Bitmap Texture_Enemy12 = Bitmap(18,24,Texture_Enemy12_d);
Bitmap Texture_Boss0 = Bitmap(48,48,Texture_Boss0_d);
Enemy::Enemy(char EnemyType, double X, double Y, int HP,double Speed = 0,int Direction = 0){
  this->EnemyType=EnemyType;
  this->X=X;
  this->Y=Y;
  this->HP=HP;
  this->Speed=Speed;
  this->Direction=Direction;
  Type=3;
  Init();
}
void Enemy::Init(){
  switch(EnemyType){
    case 0:
    Width=18;
    Height=24;
    Texture = &Texture_Enemy00;
    HitboxSize = 8;
    break;
    case 1:
    Width=18;
    Height=24;
    Texture = &Texture_Enemy10;
    HitboxSize = 8;
    break;
    case 100:
    Width=48;
    Height=48;
    Texture=&Texture_Boss0;
    HitboxSize=16;
  }
}
void Enemy::Loop(){

  if(EnemyType == 0){
    if(Ticks % 20 == 0){
      switch((Ticks / 20)%3){
        case 0:
        Texture = &Texture_Enemy00;
        break;
        case 1:
        Texture = &Texture_Enemy01;
        break;
        case 2:
        Texture = &Texture_Enemy02;
        break;
      }
    }
  }
  else if(EnemyType == 1){
    if(Ticks % 15 == 0){
      switch((Ticks / 15)%3){
        case 0:
        Texture = &Texture_Enemy10;
        break;
        case 1:
        Texture = &Texture_Enemy11;
        break;
        case 2:
        Texture = &Texture_Enemy12;
        break;
      }
    }
  }
  if(WaveID==1){
    Wave1();
  }
  else if(WaveID==2){
    Wave2();
  }
  else if(WaveID==3){
    Wave3();
  }
  else if(WaveID==100){
    Boss0();
  }
  Move();
  Ticks++;
}
void Enemy::Damage(int Value){
  HP-=Value;
  STG.Score += Value*10;
  if(HP<=0){
    if(WaveID==1){
      STG.CreateBullet(0,X,Y,1,180);
    }
    if(WaveID==100){
      Lily.Screen.drawString("StageClear!",0,236,2);
      while(1){
        delay(9999);
      }
    }
    Clear();
    STG.Score+=1000;
  }
}