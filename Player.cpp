#include "AgSTG.h"
using namespace AgSTG;
uint16_t Texture_Player_d[] PROGMEM={0x7E0, 0x7E0, 0x7E0, 0x7E0, 0x7E0, 0x7E0, 0x7E0, 0x7E0, 0x7E0, 0x7E0, 0x7E0, 0x7E0, 0x7E0,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 0x7E0, };

Bitmap Texture_Player = Bitmap(24,30,&Texture_Player_d[0]);
Player::Player(){
  X=85;Y=190;
  ID=0;
  Width=24;Height=30;
  Texture=&Texture_Player;
  Type=1;
  HitboxSize=1;
}
void Player::Loop(){
  Ticks++;
  static int16_t LX = -1;
  static int16_t LY = -1;
  if(Lily.Touch.available()){
    if(LX != -1){
      if(Lily.Touch.data.event==2){
        Move(Lily.Touch.data.x-LX,Lily.Touch.data.full_y-LY);
        LX = Lily.Touch.data.x;
        LY = Lily.Touch.data.full_y;
      }
      else{
        LX = -1;
        LY = -1;
      }
    }
    else{
      if(Lily.Touch.data.event==2){
        LX = Lily.Touch.data.x;
        LY = Lily.Touch.data.full_y;
      }
    }
  }
  if(Ticks % 6 == 0){
    Shoot();
  }
}
void Player::Miss(){
  if(STG.Life>0){
    Lily.Screen.drawString("Life:"+String(--STG.Life),0,236,2);
    X=85;
    Y=190;
    STG.ClearBullet();
  }
  else{
    Lily.Screen.drawString("Game Over!",0,236,2);
    while(1){
      delay(9999);
    }
  }
}
void Player::Shoot(){
  STG.GetID();
  STG.Objects[STG.Objectn] = new PlayerBullet(X-6,Y-4);
  STG.Objects[STG.Objectn]->ID=STG.Objectn;
  STG.GetID();
  STG.Objects[STG.Objectn] = new PlayerBullet(X+6,Y-4);
  STG.Objects[STG.Objectn]->ID=STG.Objectn;
}