#include "AgSTG.h"
using namespace AgSTG;
uint16_t Texture_Bullet0_d[] PROGMEM={0x7E0, 0x7E0, 0x7E0, 0x7E0, 0x7E0, 0x7E0, 0xFB4D, 0xFB4D, 0xFB4D, 0xFB4D, 0x7E0, 0x7E0, 0x7E0,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 0x7E0, };
uint16_t Texture_Bullet1_d[] PROGMEM={0x7E0, 0x7E0, 0x7E0, 0x25F, 0x25F, 0x7E0, 0x7E0, 0x7E0, 0x7E0, 0x7E0, 0x25F, 0xFFFF, 0xFFFF,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 0x7E0, };
uint16_t Texture_Bullet2_d[] PROGMEM={0x7E0, 0x7E0, 0x7E0, 0x18FF, 0x18FF, 0x7E0, 0x7E0, 0x7E0, 0x7E0, 0x7E0, 0x18FF, 0x94BF, 0x94BF,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 0x7E0, };
uint16_t Texture_Bullet3_d[] PROGMEM={0x7E0, 0x7E0, 0x7E0, 0xF800, 0xF800, 0x7E0, 0x7E0, 0x7E0, 0x7E0, 0x7E0, 0x7E0, 0xF800, 0xF800,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 0xF800, };
uint16_t Texture_Bullet4_d[] PROGMEM={0x7E0, 0x7E0, 0xF800, 0xF800, 0xF800, 0xF800, 0x7E0, 0x7E0, 0x7E0, 0xF800, 0xFC72, 0xFDF7, 0xFDF7,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 0x7E0, };
uint16_t Texture_Bullet5_d[] PROGMEM={0x7E0, 0x7E0, 0xF81D, 0xF81D, 0xF81D, 0xF81D, 0x7E0, 0x7E0, 0x7E0, 0xF81D, 0xFBDE, 0xFDDE, 0xFDDE,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 0x7E0, };
uint16_t Texture_Bullet6_d[] PROGMEM={0x7E0, 0x7E0, 0x101F, 0x101F, 0x101F, 0x101F, 0x7E0, 0x7E0, 0x7E0, 0x101F, 0x8C1F, 0xB59F, 0xB59F,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 0x7E0, };
Bitmap Texture_Bullet0 = Bitmap(16,16,Texture_Bullet0_d);
Bitmap Texture_Bullet1 = Bitmap(8,8,Texture_Bullet1_d);
Bitmap Texture_Bullet2 = Bitmap(8,8,Texture_Bullet2_d);
Bitmap Texture_Bullet3 = Bitmap(8,8,Texture_Bullet3_d);
Bitmap Texture_Bullet4 = Bitmap(8,8,Texture_Bullet4_d);
Bitmap Texture_Bullet5 = Bitmap(8,8,Texture_Bullet5_d);
Bitmap Texture_Bullet6 = Bitmap(8,8,Texture_Bullet6_d);
double GetAngle(double x1, double y1, double x2, double y2)
{
	double angle_temp;
	double xx, yy;
	xx = x2 - x1;
	yy = y2 - y1;
	if (xx == 0.0)
		angle_temp = pi / 2.0;
	else
		angle_temp = atan(fabs(yy / xx));
	if ((xx < 0.0) && (yy >= 0.0))
		angle_temp = pi - angle_temp;
	else if ((xx < 0.0) && (yy < 0.0))
		angle_temp = pi + angle_temp;
	else if ((xx >= 0.0) && (yy < 0.0))
		angle_temp = pi * 2.0 - angle_temp;
	return (angle_temp/pi*180+90);
}
Bullet::Bullet(char Type,double X,double Y,double Speed,int Direction){
  this->Type=4;
  BulletType=Type;
  this->X=X;
  this->Y=Y;
  this->Speed=Speed;
  this->Direction=Direction;
  Init();
}
Bullet::Bullet(char Type,double X,double Y,double Speed){
  this->Type=4;
  BulletType=Type;
  this->X=X;
  this->Y=Y;
  this->Speed=Speed;
  this->Direction=GetAngle(X,Y,STG.Objects[0]->X,STG.Objects[0]->Y);
  Init();
}
void Bullet::Init(){
  switch (BulletType){
    case 0:
    Width=16;
    Height=16;
    HitboxSize=7;
    Texture=&Texture_Bullet0;
    break;
    case 1:
    Width=8;
    Height=8;
    HitboxSize=3;
    Texture=&Texture_Bullet1;
    break;
    case 2:
    Width=8;
    Height=8;
    HitboxSize=2;
    Texture=&Texture_Bullet2;
    break;
    case 3:
    Width=8;
    Height=8;
    HitboxSize=2;
    Texture=&Texture_Bullet3;
    break;
    case 4:
    Width=8;
    Height=8;
    HitboxSize=3;
    Texture=&Texture_Bullet4;
    break;
    case 5:
    Width=8;
    Height=8;
    HitboxSize=3;
    Texture=&Texture_Bullet5;
    break;
    case 6:
    Width=8;
    Height=8;
    HitboxSize=3;
    Texture=&Texture_Bullet6;
    break;
  }
}
void Bullet::Loop(){
  Move();
  if(Judge(STG.Objects[0])){
    static_cast<Player*>(STG.Objects[0])->Miss();
  }
}